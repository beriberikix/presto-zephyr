## CMakeLists.txt
```
cmake_minimum_required(VERSION 3.20.0)
list(APPEND BOARD_ROOT ${CMAKE_CURRENT_SOURCE_DIR}/../..)
list(APPEND ZEPHYR_EXTRA_MODULES ${CMAKE_CURRENT_SOURCE_DIR}/../../drivers/presto)
find_package(Zephyr REQUIRED HINTS $ENV{ZEPHYR_BASE})
project(test_buttons)

target_sources(app PRIVATE src/main.c)
```

## prj.conf
```kconfig
CONFIG_GPIO=y
CONFIG_LOG=y
CONFIG_LOG_DEFAULT_LEVEL=3
```

## boards/native_sim.overlay
```dts
/* SPDX-License-Identifier: MIT */

#include <zephyr/dt-bindings/gpio/gpio.h>
#include <zephyr/dt-bindings/input/input-event-codes.h>

/ {
	buttons {
		compatible = "gpio-keys";
		status = "okay";

		user_sw: user_sw {
			label = "User";
			gpios = <&gpio0 0 (GPIO_PULL_UP | GPIO_ACTIVE_LOW)>;
			zephyr,code = <INPUT_KEY_0>;
		};
	};

	aliases {
		sw0 = &user_sw;
	};
};
```

## src/main.c
```c
/*
 * SPDX-License-Identifier: MIT
 *
 * Polls USER_SW (the BOOTSEL-shared button) and logs press/release edges.
 */

#include <zephyr/drivers/gpio.h>
#include <zephyr/kernel.h>
#include <zephyr/logging/log.h>

LOG_MODULE_REGISTER(test_buttons, LOG_LEVEL_INF);

static const struct gpio_dt_spec sw = GPIO_DT_SPEC_GET(DT_ALIAS(sw0), gpios);

int main(void)
{
	if (!device_is_ready(sw.port)) {
		LOG_ERR("USER_SW port not ready");
		return -ENODEV;
	}

	if (gpio_pin_configure_dt(&sw, GPIO_INPUT) != 0) {
		LOG_ERR("USER_SW configure failed");
		return -EIO;
	}

	LOG_INF("USER_SW polling started (sw0 = GP%d)", sw.pin);

	int last = -1;

	while (1) {
		int v = gpio_pin_get_dt(&sw);

		if (v >= 0 && v != last) {
			last = v;
			LOG_INF("USER_SW: %s", v ? "pressed" : "released");
		}

		k_msleep(20);
	}

	return 0;
}
```
