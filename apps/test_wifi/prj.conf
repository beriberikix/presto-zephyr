## CMakeLists.txt
```
cmake_minimum_required(VERSION 3.20.0)
list(APPEND BOARD_ROOT ${CMAKE_CURRENT_SOURCE_DIR}/../..)
list(APPEND ZEPHYR_EXTRA_MODULES ${CMAKE_CURRENT_SOURCE_DIR}/../../drivers/presto)
find_package(Zephyr REQUIRED HINTS $ENV{ZEPHYR_BASE})
project(test_wifi)

target_sources(app PRIVATE src/main.c)
```

## prj.conf
```kconfig
CONFIG_NETWORKING=y
CONFIG_NET_L2_WIFI_MGMT=y
CONFIG_WIFI=y
CONFIG_NET_MGMT=y
CONFIG_HEAP_MEM_POOL_SIZE=16384
CONFIG_LOG=y
CONFIG_LOG_DEFAULT_LEVEL=3
```

## prj_wifi.conf
```kconfig
CONFIG_WIFI_AIROC=y
CONFIG_CYW43439=y
CONFIG_CYW43439_MURATA_1YN=y
CONFIG_HEAP_MEM_POOL_SIZE=16384

# The AIROC/WHD CYW43439 bring-up (firmware download + deep nested calls
# over PIO-SPI) overflows the default 1 KB stacks, corrupting a return
# address -> usage fault (~3 s into boot). 4 KB is enough to init cleanly.
CONFIG_MAIN_STACK_SIZE=4096
CONFIG_SYSTEM_WORKQUEUE_STACK_SIZE=4096
```

## boards/native_sim_native_64.conf
```kconfig
# No Wi-Fi hardware on native_sim — drop the entire net/wifi stack so the
# binary still smokes cleanly.
CONFIG_NETWORKING=n
CONFIG_NET_L2_WIFI_MGMT=n
CONFIG_WIFI=n
CONFIG_NET_MGMT=n
CONFIG_HEAP_MEM_POOL_SIZE=0
```

## boards/presto_rp2350b_m33.overlay
```dts
/* SPDX-License-Identifier: MIT */

&airoc_wifi {
	status = "okay";
};
```

## src/main.c
```c
/*
 * SPDX-License-Identifier: MIT
 *
 * Brings up the default network interface (CYW43439 on RM2) and logs a
 * heartbeat. Apply the Wi-Fi overlay + prj_wifi.conf to actually enable the
 * radio — see this app's README in the repo top-level for the command.
 */

#include <zephyr/kernel.h>
#include <zephyr/logging/log.h>

LOG_MODULE_REGISTER(test_wifi, LOG_LEVEL_INF);

#if !IS_ENABLED(CONFIG_NETWORKING)

int main(void)
{
	LOG_INF("Networking disabled in this build (CONFIG_NETWORKING=n)");

	while (1) {
		k_msleep(1000);
	}

	return 0;
}

#else

#include <zephyr/net/net_if.h>

int main(void)
{
	struct net_if *iface = net_if_get_default();

	if (iface == NULL) {
		LOG_ERR("No default network interface — is the Wi-Fi overlay applied?");
		return -ENODEV;
	}

	LOG_INF("Default network interface acquired (idx=%d)", net_if_get_by_iface(iface));

	while (1) {
		k_msleep(1000);
	}

	return 0;
}

#endif /* CONFIG_NETWORKING */
```
