## CMakeLists.txt
```
cmake_minimum_required(VERSION 3.20.0)
list(APPEND BOARD_ROOT ${CMAKE_CURRENT_SOURCE_DIR}/../..)
list(APPEND ZEPHYR_EXTRA_MODULES ${CMAKE_CURRENT_SOURCE_DIR}/../../drivers/presto)
find_package(Zephyr REQUIRED HINTS $ENV{ZEPHYR_BASE})
project(wifi_display)

target_sources(app PRIVATE src/main.c)
```

## Kconfig
```
# wifi_display application options
# SPDX-License-Identifier: MIT

mainmenu "Pimoroni Presto Wi-Fi + display demo"

config WIFI_DISPLAY_SSID
	string "Wi-Fi SSID to connect to"
	default ""
	help
	  SSID of the WPA2-PSK access point to join. Leave empty and set it in a
	  local (un-committed) conf file or via menuconfig, e.g.
	  CONFIG_WIFI_DISPLAY_SSID="my-network".

config WIFI_DISPLAY_PSK
	string "Wi-Fi WPA2 PSK"
	default ""
	help
	  Pre-shared key for the access point. An empty PSK is treated as an open
	  network.

config WIFI_DISPLAY_HTTP_HOST
	string "HTTP host to GET as the connectivity proof"
	default "example.com"

config WIFI_DISPLAY_HTTP_PATH
	string "HTTP path to GET"
	default "/"

config WIFI_DISPLAY_HTTP_PORT
	int "HTTP port"
	default 80

source "Kconfig.zephyr"
```

## prj.conf
```kconfig
# Wi-Fi + display coexistence demo (portable bits).
#
# Hardware-only options (half-res framebuffer, AIROC driver) live in
# boards/presto_rp2350b_m33.conf; native_sim disables networking in
# boards/native_sim_native_64.conf and just exercises the display via SDL.

CONFIG_LOG=y
CONFIG_LOG_DEFAULT_LEVEL=3

# Display (resolved through chosen zephyr,display)
CONFIG_GPIO=y
CONFIG_DISPLAY=y

# Networking core
CONFIG_NETWORKING=y
CONFIG_NET_IPV4=y
CONFIG_NET_IPV6=n
CONFIG_NET_DHCPV4=y
CONFIG_NET_UDP=y
CONFIG_NET_TCP=y
CONFIG_NET_SOCKETS=y
CONFIG_DNS_RESOLVER=y

# A static resolver guarantees name resolution even if the AP's DHCP offer
# carries no DNS option.
CONFIG_DNS_SERVER_IP_ADDRESSES=y
CONFIG_DNS_SERVER1="8.8.8.8"

# Management events (connect result + IPv4 address add drive the state machine)
CONFIG_NET_MGMT=y
CONFIG_NET_MGMT_EVENT=y
CONFIG_NET_MGMT_EVENT_INFO=y

# Wi-Fi
CONFIG_WIFI=y
CONFIG_NET_L2_WIFI_MGMT=y

# Buffers / heap sized for a small TLS-less HTTP fetch over the freed SRAM.
CONFIG_HEAP_MEM_POOL_SIZE=65536
CONFIG_NET_PKT_RX_COUNT=16
CONFIG_NET_PKT_TX_COUNT=16
CONFIG_NET_BUF_RX_COUNT=32
CONFIG_NET_BUF_TX_COUNT=32

# The AIROC/WHD CYW43439 bring-up overflows the default 1 KB stacks.
CONFIG_MAIN_STACK_SIZE=4096
CONFIG_SYSTEM_WORKQUEUE_STACK_SIZE=4096
```

## boards/native_sim_native_64.conf
```kconfig
# native_sim has no CYW43439 and no PSRAM: disable networking/Wi-Fi so the app
# still builds and exercises the drawing layer on the SDL display (the
# native_sim board provides sdl_dc as chosen zephyr,display). The framebuffer
# stays in SRAM (the PSRAM Kconfig dependency is unmet here).
CONFIG_DISPLAY=y
CONFIG_SDL_DISPLAY=y

CONFIG_NETWORKING=n
CONFIG_NET_L2_WIFI_MGMT=n
CONFIG_NET_MGMT=n
CONFIG_WIFI=n
CONFIG_NET_IPV4=n
CONFIG_NET_DHCPV4=n
CONFIG_NET_TCP=n
CONFIG_NET_UDP=n
CONFIG_NET_SOCKETS=n
CONFIG_DNS_RESOLVER=n
```

## boards/presto_rp2350b_m33.conf
```kconfig
# Hardware-only options for the Presto board: drive the display from a
# half-resolution 240x240 framebuffer (115 KB, scanned out of SRAM) so the
# CYW43439 networking stack fits in the freed SRAM, and enable the driver.
CONFIG_ST7701_PRESTO_HALF_RES=y

CONFIG_WIFI_AIROC=y
CONFIG_CYW43439=y
CONFIG_CYW43439_MURATA_1YN=y
```

## boards/presto_rp2350b_m33.overlay
```dts
/*
 * SPDX-License-Identifier: MIT
 *
 * Enable the ST7701 panel (system display) and the CYW43439 radio together.
 * The board conf selects the half-resolution framebuffer (240x240 in SRAM), so
 * the display scanout and the Wi-Fi stack coexist in the freed SRAM.
 */

/ {
	chosen {
		zephyr,display = &st7701;
	};
};

&st7701 {
	status = "okay";
};

&airoc_wifi {
	status = "okay";
};
```

## src/main.c
```c
/*
 * Wi-Fi + display coexistence demo for the Pimoroni Presto.
 *
 * Proves the freed-SRAM coexistence end to end: the ST7701 panel is driven from
 * a half-resolution 240x240 SRAM framebuffer (boards/presto_rp2350b_m33.conf
 * selects CONFIG_ST7701_PRESTO_HALF_RES, leaving SRAM for the net stack) while
 * the CYW43439 stack associates to an AP, takes a DHCP lease, resolves a name
 * and does a plain-HTTP GET. The display is filled with a status colour at each
 * phase, so the panel visibly tracks the network state while traffic runs:
 *
 *   amber  connecting        cyan   DHCP lease bound
 *   blue   Wi-Fi associated  green  HTTP GET succeeded
 *   red    error             grey   no Wi-Fi (native_sim)
 *
 * On native_sim there is no radio: networking is disabled and the app just
 * exercises the drawing layer on the SDL display.
 *
 * Copyright (c) 2026 Jonathan Beri
 * SPDX-License-Identifier: MIT
 */

#include <zephyr/kernel.h>
#include <zephyr/device.h>
#include <zephyr/drivers/display.h>
#include <zephyr/logging/log.h>
#include <stdio.h>
#include <string.h>

LOG_MODULE_REGISTER(wifi_display, LOG_LEVEL_INF);

/* Status colours (standard little-endian RGB565; display_write byteswaps). */
#define COL_AMBER 0xFD20
#define COL_BLUE  0x001F
#define COL_CYAN  0x07FF
#define COL_GREEN 0x07E0
#define COL_RED   0xF800
#define COL_GREY  0x8410

#define MAX_WIDTH 480
#define CHUNK_H   16

static uint16_t chunk_buf[MAX_WIDTH * CHUNK_H];

static const struct device *disp;
static uint16_t disp_w, disp_h;

#if IS_ENABLED(CONFIG_ST7701_PRESTO_DOUBLE_BUFFER)
/* Provided by the ST7701 driver: present the back buffer at the next vblank. */
extern void st7701_presto_flip(const struct device *dev);
#endif

/* Fill the whole panel with one colour, CHUNK_H rows at a time. */
static void fill_screen(uint16_t color)
{
	struct display_buffer_descriptor desc = {
		.width = disp_w,
		.pitch = disp_w,
	};

	if (disp == NULL) {
		return;
	}

	for (uint16_t i = 0; i < disp_w * CHUNK_H; i++) {
		chunk_buf[i] = color;
	}

	for (uint16_t y = 0; y < disp_h; y += CHUNK_H) {
		uint16_t rows = MIN(CHUNK_H, disp_h - y);

		desc.height = rows;
		desc.buf_size = (size_t)disp_w * rows * sizeof(uint16_t);
		display_write(disp, 0, y, &desc, chunk_buf);
	}

#if IS_ENABLED(CONFIG_ST7701_PRESTO_DOUBLE_BUFFER)
	/* Present the fill if the driver is double-buffered (else this is a no-op
	 * and the writes above already went to the live scanout buffer).
	 */
	st7701_presto_flip(disp);
#endif
}

static int display_init(void)
{
	struct display_capabilities caps;

	disp = DEVICE_DT_GET(DT_CHOSEN(zephyr_display));
	if (!device_is_ready(disp)) {
		LOG_ERR("display device not ready");
		disp = NULL;
		return -ENODEV;
	}

	(void)display_set_pixel_format(disp, PIXEL_FORMAT_RGB_565);
	display_get_capabilities(disp, &caps);
	disp_w = MIN(caps.x_resolution, MAX_WIDTH);
	disp_h = caps.y_resolution;
	display_blanking_off(disp);
	LOG_INF("display %ux%u ready", disp_w, disp_h);
	return 0;
}

#if IS_ENABLED(CONFIG_WIFI)

#include <zephyr/net/net_if.h>
#include <zephyr/net/net_mgmt.h>
#include <zephyr/net/net_event.h>
#include <zephyr/net/wifi_mgmt.h>
#include <zephyr/net/dhcpv4.h>
#include <zephyr/net/socket.h>

#define WIFI_MGMT_EVENTS (NET_EVENT_WIFI_CONNECT_RESULT | NET_EVENT_WIFI_DISCONNECT_RESULT)

static struct net_mgmt_event_callback wifi_cb;
static struct net_mgmt_event_callback ipv4_cb;

static K_SEM_DEFINE(wifi_connected, 0, 1);
static K_SEM_DEFINE(ipv4_bound, 0, 1);
static volatile int wifi_status;
static char ip_str[NET_IPV4_ADDR_LEN];

static void wifi_evt(struct net_mgmt_event_callback *cb, uint64_t event, struct net_if *iface)
{
	ARG_UNUSED(iface);

	if (event == NET_EVENT_WIFI_CONNECT_RESULT) {
		const struct wifi_status *st = (const struct wifi_status *)cb->info;

		wifi_status = st->status;
		k_sem_give(&wifi_connected);
	} else if (event == NET_EVENT_WIFI_DISCONNECT_RESULT) {
		LOG_WRN("Wi-Fi disconnected");
	}
}

static void ipv4_evt(struct net_mgmt_event_callback *cb, uint64_t event, struct net_if *iface)
{
	ARG_UNUSED(cb);

	if (event != NET_EVENT_IPV4_ADDR_ADD || iface->config.ip.ipv4 == NULL) {
		return;
	}

	for (int i = 0; i < NET_IF_MAX_IPV4_ADDR; i++) {
		if (iface->config.ip.ipv4->unicast[i].ipv4.addr_type != NET_ADDR_DHCP) {
			continue;
		}
		net_addr_ntop(NET_AF_INET,
			      &iface->config.ip.ipv4->unicast[i].ipv4.address.in_addr,
			      ip_str, sizeof(ip_str));
		k_sem_give(&ipv4_bound);
		return;
	}
}

static int wifi_connect(struct net_if *iface)
{
	struct wifi_connect_req_params params = {
		.ssid = (const uint8_t *)CONFIG_WIFI_DISPLAY_SSID,
		.ssid_length = sizeof(CONFIG_WIFI_DISPLAY_SSID) - 1,
		.psk = (const uint8_t *)CONFIG_WIFI_DISPLAY_PSK,
		.psk_length = sizeof(CONFIG_WIFI_DISPLAY_PSK) - 1,
		.security = (sizeof(CONFIG_WIFI_DISPLAY_PSK) - 1) ? WIFI_SECURITY_TYPE_PSK
								  : WIFI_SECURITY_TYPE_NONE,
		.channel = WIFI_CHANNEL_ANY,
		.band = WIFI_FREQ_BAND_2_4_GHZ,
		.mfp = WIFI_MFP_OPTIONAL,
	};

	LOG_INF("connecting to SSID \"%s\"", CONFIG_WIFI_DISPLAY_SSID);
	return net_mgmt(NET_REQUEST_WIFI_CONNECT, iface, &params, sizeof(params));
}

/* Plain-HTTP GET as the connectivity proof. Returns 0 on a 2xx response. */
static int http_get(void)
{
	const char *host = CONFIG_WIFI_DISPLAY_HTTP_HOST;
	const char *path = CONFIG_WIFI_DISPLAY_HTTP_PATH;
	char port[8];
	struct zsock_addrinfo hints = {
		.ai_family = AF_INET,
		.ai_socktype = SOCK_STREAM,
	};
	struct zsock_addrinfo *res = NULL;
	char req[256];
	char resp[256];
	int sock = -1;
	int ret;

	snprintf(port, sizeof(port), "%d", CONFIG_WIFI_DISPLAY_HTTP_PORT);

	ret = zsock_getaddrinfo(host, port, &hints, &res);
	if (ret != 0 || res == NULL) {
		LOG_ERR("DNS resolve of %s failed (%d)", host, ret);
		return -EIO;
	}
	LOG_INF("resolved %s", host);

	sock = zsock_socket(res->ai_family, res->ai_socktype, res->ai_protocol);
	if (sock < 0) {
		LOG_ERR("socket() failed (%d)", errno);
		ret = -errno;
		goto out;
	}

	if (zsock_connect(sock, res->ai_addr, res->ai_addrlen) < 0) {
		LOG_ERR("connect() to %s:%s failed (%d)", host, port, errno);
		ret = -errno;
		goto out;
	}

	ret = snprintf(req, sizeof(req),
		       "GET %s HTTP/1.1\r\nHost: %s\r\nConnection: close\r\n"
		       "User-Agent: presto-zephyr\r\n\r\n",
		       path, host);
	if (ret < 0 || ret >= (int)sizeof(req)) {
		LOG_ERR("request too long for %s%s", host, path);
		ret = -EINVAL;
		goto out;
	}
	if (zsock_send(sock, req, ret, 0) < 0) {
		LOG_ERR("send() failed (%d)", errno);
		ret = -errno;
		goto out;
	}

	ret = zsock_recv(sock, resp, sizeof(resp) - 1, 0);
	if (ret <= 0) {
		LOG_ERR("recv() failed (%d)", errno);
		ret = -EIO;
		goto out;
	}
	resp[ret] = '\0';

	/* First line is "HTTP/1.x NNN ..." */
	if (strncmp(resp, "HTTP/1.", 7) == 0) {
		int code = atoi(resp + 9);
		const char *eol = strchr(resp, '\r');
		int line_len = eol ? (int)(eol - resp) : (int)strlen(resp);

		LOG_INF("HTTP response: %.*s", line_len, resp);
		ret = (code >= 200 && code < 400) ? 0 : -EIO;
	} else {
		LOG_ERR("unexpected response");
		ret = -EIO;
	}

out:
	if (sock >= 0) {
		zsock_close(sock);
	}
	if (res != NULL) {
		zsock_freeaddrinfo(res);
	}
	return ret;
}

static int run_network(void)
{
	struct net_if *iface = net_if_get_default();

	if (iface == NULL) {
		LOG_ERR("no default network interface");
		return -ENODEV;
	}

	if (sizeof(CONFIG_WIFI_DISPLAY_SSID) - 1 == 0) {
		LOG_ERR("CONFIG_WIFI_DISPLAY_SSID is empty — set it to your AP's SSID");
		return -EINVAL;
	}

	net_mgmt_init_event_callback(&wifi_cb, wifi_evt, WIFI_MGMT_EVENTS);
	net_mgmt_add_event_callback(&wifi_cb);
	net_mgmt_init_event_callback(&ipv4_cb, ipv4_evt, NET_EVENT_IPV4_ADDR_ADD);
	net_mgmt_add_event_callback(&ipv4_cb);

	if (wifi_connect(iface) != 0) {
		LOG_ERR("connect request failed");
		return -EIO;
	}

	if (k_sem_take(&wifi_connected, K_SECONDS(30)) != 0) {
		LOG_ERR("timed out waiting for association");
		return -ETIMEDOUT;
	}
	if (wifi_status != 0) {
		LOG_ERR("association failed (status %d)", wifi_status);
		return -ECONNREFUSED;
	}
	LOG_INF("associated; requesting DHCP lease");
	fill_screen(COL_BLUE);

	net_dhcpv4_start(iface);
	if (k_sem_take(&ipv4_bound, K_SECONDS(30)) != 0) {
		LOG_ERR("timed out waiting for DHCP lease");
		return -ETIMEDOUT;
	}
	LOG_INF("DHCP lease: %s", ip_str);
	fill_screen(COL_CYAN);

	return http_get();
}

#endif /* CONFIG_WIFI */

int main(void)
{
	display_init();
	fill_screen(COL_AMBER);

#if IS_ENABLED(CONFIG_WIFI)
	int ret = run_network();

	if (ret == 0) {
		LOG_INF("connectivity proof OK — Wi-Fi and display coexisting");
		fill_screen(COL_GREEN);
	} else {
		LOG_ERR("network bring-up failed (%d)", ret);
		fill_screen(COL_RED);
	}
#else
	LOG_INF("Wi-Fi disabled in this build (native_sim?) — display only");
	fill_screen(COL_GREY);
#endif

	/* Keep the panel scanning out (it runs off the driver's DMA/ISRs). */
	uint32_t beat = 0;

	while (1) {
		k_msleep(1000);
		LOG_DBG("alive %u", beat++);
	}

	return 0;
}
```
