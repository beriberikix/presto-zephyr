/*
 * SPDX-License-Identifier: MIT
 *
 * RGB565 drawing primitives for kitchen_sink (see gfx.h).
 *
 * The 8x8 glyph table is font8x8_basic by Daniel Hepper
 * (github.com/dhepper/font8x8), released into the public domain. Each glyph is
 * 8 bytes (one per row); within a row the least-significant bit is the leftmost
 * column.
 */

#include <zephyr/kernel.h>
#include <zephyr/device.h>
#include <zephyr/drivers/display.h>
#include <string.h>

#include "gfx.h"

/* Design resolution: the Presto panel is 240x240 at half-res. Larger displays
 * (e.g. native_sim SDL) are letterboxed into the top-left 240x240.
 */
#define GFX_MAX_W 240
#define GFX_MAX_H 240
#define CHUNK_H   16
#define GLYPH_MAX_SCALE 4

#if IS_ENABLED(CONFIG_ST7701_PRESTO_DOUBLE_BUFFER)
extern void st7701_presto_flip(const struct device *dev);
#endif

static const struct device *disp;
static uint16_t g_w, g_h;

/* Scratch band buffer for rectangle fills, and a glyph buffer for text. */
static uint16_t chunk_buf[GFX_MAX_W * CHUNK_H];
static uint16_t glyph_buf[(8 * GLYPH_MAX_SCALE) * (8 * GLYPH_MAX_SCALE)];

/* ASCII 0x20-0x7F (96 glyphs). */
static const uint8_t font8x8[96][8] = {
	{0x00, 0x00, 0x00, 0x00, 0x00, 0x00, 0x00, 0x00}, /* ' ' */
	{0x18, 0x3C, 0x3C, 0x18, 0x18, 0x00, 0x18, 0x00}, /* '!' */
	{0x36, 0x36, 0x00, 0x00, 0x00, 0x00, 0x00, 0x00}, /* '"' */
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	{0x00, 0x00, 0x00, 0x00, 0x00, 0x00, 0x00, 0x00}, /* 0x7F */
};

int gfx_init(void)
{
	struct display_capabilities caps;

	disp = DEVICE_DT_GET(DT_CHOSEN(zephyr_display));
	if (!device_is_ready(disp)) {
		disp = NULL;
		return -ENODEV;
	}

	(void)display_set_pixel_format(disp, PIXEL_FORMAT_RGB_565);
	display_get_capabilities(disp, &caps);
	g_w = MIN(caps.x_resolution, GFX_MAX_W);
	g_h = MIN(caps.y_resolution, GFX_MAX_H);
	display_blanking_off(disp);
	return 0;
}

bool gfx_ready(void)
{
	return disp != NULL;
}

uint16_t gfx_width(void)
{
	return g_w;
}

uint16_t gfx_height(void)
{
	return g_h;
}

void gfx_fill_rect(int x, int y, int w, int h, uint16_t color)
{
	struct display_buffer_descriptor desc;

	if (disp == NULL) {
		return;
	}

	/* Clip to the screen. */
	if (x < 0) {
		w += x;
		x = 0;
	}
	if (y < 0) {
		h += y;
		y = 0;
	}
	if (x + w > g_w) {
		w = g_w - x;
	}
	if (y + h > g_h) {
		h = g_h - y;
	}
	if (w <= 0 || h <= 0) {
		return;
	}

	for (int i = 0; i < w * CHUNK_H; i++) {
		chunk_buf[i] = color;
	}

	desc.width = w;
	desc.pitch = w;
	for (int yy = y; yy < y + h; yy += CHUNK_H) {
		int rows = MIN(CHUNK_H, y + h - yy);

		desc.height = rows;
		desc.buf_size = (size_t)w * rows * sizeof(uint16_t);
		(void)display_write(disp, x, yy, &desc, chunk_buf);
	}
}

void gfx_clear(uint16_t color)
{
	gfx_fill_rect(0, 0, g_w, g_h, color);
}

void gfx_text(int x, int y, const char *s, uint16_t fg, uint16_t bg, int scale)
{
	struct display_buffer_descriptor desc;

	if (disp == NULL || s == NULL) {
		return;
	}
	if (scale < 1) {
		scale = 1;
	}
	if (scale > GLYPH_MAX_SCALE) {
		scale = GLYPH_MAX_SCALE;
	}

	const int gw = 8 * scale;

	desc.width = gw;
	desc.height = gw;
	desc.pitch = gw;
	desc.buf_size = (size_t)gw * gw * sizeof(uint16_t);

	for (const char *p = s; *p != '\0'; p++, x += gw) {
		uint8_t c = (uint8_t)*p;
		const uint8_t *rows;

		if (x >= g_w) {
			break;
		}
		if (c < 0x20 || c > 0x7F) {
			c = '?';
		}
		rows = font8x8[c - 0x20];

		for (int ry = 0; ry < 8; ry++) {
			for (int rx = 0; rx < 8; rx++) {
				uint16_t px = (rows[ry] >> rx) & 1 ? fg : bg;

				for (int sy = 0; sy < scale; sy++) {
					uint16_t *line = &glyph_buf[(ry * scale + sy) * gw + rx * scale];

					for (int sx = 0; sx < scale; sx++) {
						line[sx] = px;
					}
				}
			}
		}

		(void)display_write(disp, x, y, &desc, glyph_buf);
	}
}

int gfx_text_w(const char *s, int scale)
{
	if (scale < 1) {
		scale = 1;
	}
	return (int)strlen(s) * 8 * scale;
}

void gfx_present(void)
{
#if IS_ENABLED(CONFIG_ST7701_PRESTO_DOUBLE_BUFFER)
	if (disp != NULL) {
		st7701_presto_flip(disp);
	}
#endif
}
