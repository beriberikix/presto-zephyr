## CMakeLists.txt
```
cmake_minimum_required(VERSION 3.20.0)
list(APPEND BOARD_ROOT ${CMAKE_CURRENT_SOURCE_DIR}/../..)
list(APPEND ZEPHYR_EXTRA_MODULES ${CMAKE_CURRENT_SOURCE_DIR}/../../drivers/presto)
find_package(Zephyr REQUIRED HINTS $ENV{ZEPHYR_BASE})
project(kitchen_sink)

target_sources(app PRIVATE
	src/main.c
	src/gfx.c
	src/ui.c
	src/touch.c
	src/screen_neopixel.c
	src/screen_button.c
	src/screen_touch.c
	src/screen_wifi.c
	src/screen_psram.c
)
```

## Kconfig
```
# kitchen_sink application options
# SPDX-License-Identifier: MIT

mainmenu "Pimoroni Presto kitchen sink demo"

config KITCHEN_SINK_WIFI_SSID
	string "Wi-Fi SSID for the Wi-Fi screen"
	default ""
	help
	  SSID the Wi-Fi screen joins. Leave empty and set it in an untracked
	  wifi_creds.conf (gitignored), e.g. CONFIG_KITCHEN_SINK_WIFI_SSID="net".
	  Empty means the Wi-Fi screen just shows "(no SSID set)".

config KITCHEN_SINK_WIFI_PSK
	string "Wi-Fi WPA2 PSK"
	default ""
	help
	  Pre-shared key for the AP. Empty is treated as an open network.

source "Kconfig.zephyr"
```

## prj.conf
```kconfig
# Kitchen-sink demo: all features on the display, touch-swipe navigation.
# Hardware-only options (half-res/double-buffer display, PSRAM, CYW43439) live
# in boards/presto_rp2350b_m33.conf; native_sim overrides are in
# boards/native_sim_native_64.conf. No shell — it is dropped to keep SRAM for the second
# framebuffer + the Wi-Fi stack.

CONFIG_LOG=y
CONFIG_LOG_DEFAULT_LEVEL=3

# Display (resolved through chosen zephyr,display; SDL on native_sim)
CONFIG_DISPLAY=y
CONFIG_GPIO=y

# Capacitive touch (FT6236 over bit-bang I2C)
CONFIG_I2C=y
CONFIG_INPUT=y
CONFIG_INPUT_FT6146=y

# 7x SK6812 NeoPixels on GP33, driven over PIO2 by the Presto-local fork of the
# WS2812 PIO driver (drivers/presto/drivers/led_strip) — the upstream
# WS2812_STRIP_RPI_PICO_PIO can't reach a GPIO > 31 on RP2350B.
CONFIG_LED_STRIP=y
CONFIG_WS2812_STRIP_PRESTO_PIO=y

# Networking for the Wi-Fi screen (the CYW43439 driver is enabled per-board)
CONFIG_NETWORKING=y
CONFIG_NET_L2_WIFI_MGMT=y
CONFIG_WIFI=y
CONFIG_NET_IPV4=y
CONFIG_NET_DHCPV4=y
CONFIG_NET_MGMT=y
CONFIG_NET_MGMT_EVENT=y
CONFIG_NET_MGMT_EVENT_INFO=y
CONFIG_HEAP_MEM_POOL_SIZE=16384
```

## boards/native_sim.conf
```kconfig
# Strip the hardware-only drivers — keeps native_sim smoking green.
CONFIG_LED_STRIP=n
CONFIG_WS2812_STRIP_RPI_PICO_PIO=n
CONFIG_INPUT_FT6146=n
CONFIG_I2C=n
CONFIG_NETWORKING=n
CONFIG_NET_L2_WIFI_MGMT=n
CONFIG_WIFI=n
CONFIG_NET_MGMT=n
```

## boards/native_sim_native_64.conf
```kconfig
# native_sim: draw the screens on the SDL display, strip hardware-only drivers.
CONFIG_DISPLAY=y
CONFIG_SDL_DISPLAY=y

CONFIG_LED_STRIP=n
CONFIG_WS2812_STRIP_RPI_PICO_PIO=n
CONFIG_INPUT_FT6146=n
CONFIG_I2C=n
CONFIG_NETWORKING=n
CONFIG_NET_L2_WIFI_MGMT=n
CONFIG_WIFI=n
CONFIG_NET_IPV4=n
CONFIG_NET_DHCPV4=n
CONFIG_NET_MGMT=n
CONFIG_NET_MGMT_EVENT=n
```

## boards/presto_rp2350b_m33.conf
```kconfig
# Hardware-only options for the Presto board.

# Drive the panel from a half-resolution 240x240 framebuffer (frees SRAM for the
# Wi-Fi stack) with tear-free double-buffering for the screen redraws.
CONFIG_ST7701_PRESTO_HALF_RES=y
CONFIG_ST7701_PRESTO_DOUBLE_BUFFER=y

# 8 MB PSRAM (for the PSRAM screen).
CONFIG_PIMORONI_RP2350_PSRAM=y

# CYW43439 Wi-Fi driver.
CONFIG_WIFI_AIROC=y
CONFIG_CYW43439=y
CONFIG_CYW43439_MURATA_1YN=y

# The AIROC/WHD bring-up overflows the default 1 KB stacks.
CONFIG_MAIN_STACK_SIZE=4096
CONFIG_SYSTEM_WORKQUEUE_STACK_SIZE=4096
```

## boards/native_sim_native_64.overlay
```dts
/* SPDX-License-Identifier: MIT */

#include <zephyr/dt-bindings/gpio/gpio.h>
#include <zephyr/dt-bindings/input/input-event-codes.h>

/*
 * Provide just the button alias for native_sim. The LED-strip and touch
 * screens detect missing hardware via IS_ENABLED and degrade gracefully.
 */

/ {
	buttons {
		compatible = "gpio-keys";
		status = "okay";

		user_sw: user_sw {
			label = "User";
			gpios = <&gpio0 1 (GPIO_PULL_UP | GPIO_ACTIVE_LOW)>;
			zephyr,code = <INPUT_KEY_0>;
		};
	};

	aliases {
		sw0 = &user_sw;
	};
};
```

## boards/presto_rp2350b_m33.overlay
```dts
/* SPDX-License-Identifier: MIT */

/* Make the ST7701 the system display and enable it + the CYW43439 radio. */
/ {
	chosen {
		zephyr,display = &st7701;
	};
};

&st7701 {
	status = "okay";
};

&airoc_wifi {
	status = "okay";
};
```

## src/main.c
```c
/*
 * SPDX-License-Identifier: MIT
 *
 * Kitchen-sink demo. Renders five feature screens — neopixel, button, touch,
 * wifi, psram — on the ST7701 panel. Navigate by swiping left/right on the
 * touchscreen or pressing USER_SW; there is no auto-advance.
 *
 * Each screen fully repaints in render(); because the driver is double-buffered
 * the back buffer is two frames stale after a flip, so a change repaints for two
 * consecutive presents (redraw_frames). Animated screens report a change every
 * tick and so repaint continuously.
 */

#include <zephyr/drivers/gpio.h>
#include <zephyr/kernel.h>
#include <zephyr/logging/log.h>

#include "gfx.h"
#include "screens.h"
#include "touch.h"

LOG_MODULE_REGISTER(kitchen_sink, LOG_LEVEL_INF);

#define TICK_MS       50
#define REDRAW_FRAMES 2

static const struct gpio_dt_spec sw = GPIO_DT_SPEC_GET(DT_ALIAS(sw0), gpios);

static const struct screen *(*const factories[])(void) = {
	screen_neopixel,
	screen_button,
	screen_touch,
	screen_wifi,
	screen_psram,
};

static const struct screen *screens[ARRAY_SIZE(factories)];
static size_t current;
static int last_button;
static int redraw_frames;

static void show(size_t idx)
{
	if (screens[current] != NULL && screens[current]->leave != NULL) {
		screens[current]->leave();
	}

	current = idx;

	const struct screen *s = screens[current];

	LOG_INF("--- screen: %s ---", s->name);
	if (s->enter != NULL) {
		(void)s->enter();
	}
	redraw_frames = REDRAW_FRAMES;
}

static size_t step_idx(int delta)
{
	int n = ARRAY_SIZE(screens);

	return (size_t)(((int)current + delta + n) % n);
}

int main(void)
{
	for (size_t i = 0; i < ARRAY_SIZE(factories); i++) {
		screens[i] = factories[i]();
	}

	(void)gfx_init();
	if (!gfx_ready()) {
		LOG_WRN("no display — navigation/logic still runs headless");
	}

	if (device_is_ready(sw.port)) {
		(void)gpio_pin_configure_dt(&sw, GPIO_INPUT);
	} else {
		LOG_WRN("USER_SW not ready");
	}

	LOG_INF("kitchen_sink: %u screens — swipe or USER_SW to navigate",
		(unsigned)ARRAY_SIZE(screens));

	last_button = -1;
	show(0);

	while (1) {
		if (screens[current]->update != NULL && screens[current]->update()) {
			redraw_frames = REDRAW_FRAMES;
		}

		/* Navigation: touch swipe, then USER_SW rising edge. */
		switch (touch_nav_take()) {
		case NAV_LEFT:
			show(step_idx(+1));
			break;
		case NAV_RIGHT:
			show(step_idx(-1));
			break;
		default:
			break;
		}

		int v = gpio_pin_get_dt(&sw);

		if (v == 1 && last_button == 0) {
			show(step_idx(+1));
		}
		if (v >= 0) {
			last_button = v;
		}

		if (redraw_frames > 0 && gfx_ready()) {
			if (screens[current]->render != NULL) {
				screens[current]->render();
			}
			gfx_present();
			redraw_frames--;
		}

		k_msleep(TICK_MS);
	}

	return 0;
}
```

## src/gfx.c
```c
/*
 * SPDX-License-Identifier: MIT
 *
 * RGB565 drawing primitives for kitchen_sink (see gfx.h).
 *
 * The 8x8 glyph table is font8x8_basic by Daniel Hepper
 * (github.com/dhepper/font8x8), released into the public domain. Each glyph is
 * 8 bytes (one per row); within a row the least-significant bit is the leftmost
 * column.
 */

#include <zephyr/kernel.h>
#include <zephyr/device.h>
#include <zephyr/drivers/display.h>
#include <string.h>

#include "gfx.h"

/* Design resolution: the Presto panel is 240x240 at half-res. Larger displays
 * (e.g. native_sim SDL) are letterboxed into the top-left 240x240.
 */
#define GFX_MAX_W 240
#define GFX_MAX_H 240
#define CHUNK_H   16
#define GLYPH_MAX_SCALE 4

#if IS_ENABLED(CONFIG_ST7701_PRESTO_DOUBLE_BUFFER)
extern void st7701_presto_flip(const struct device *dev);
#endif

static const struct device *disp;
static uint16_t g_w, g_h;

/* Scratch band buffer for rectangle fills, and a glyph buffer for text. */
static uint16_t chunk_buf[GFX_MAX_W * CHUNK_H];
static uint16_t glyph_buf[(8 * GLYPH_MAX_SCALE) * (8 * GLYPH_MAX_SCALE)];

/* ASCII 0x20-0x7F (96 glyphs). */
static const uint8_t font8x8[96][8] = {
	{0x00, 0x00, 0x00, 0x00, 0x00, 0x00, 0x00, 0x00}, /* ' ' */
	{0x18, 0x3C, 0x3C, 0x18, 0x18, 0x00, 0x18, 0x00}, /* '!' */
	{0x36, 0x36, 0x00, 0x00, 0x00, 0x00, 0x00, 0x00}, /* '"' */
	{0x36, 0x36, 0x7F, 0x36, 0x7F, 0x36, 0x36, 0x00}, /* '#' */
	{0x0C, 0x3E, 0x03, 0x1E, 0x30, 0x1F, 0x0C, 0x00}, /* '$' */
	{0x00, 0x63, 0x33, 0x18, 0x0C, 0x66, 0x63, 0x00}, /* '%' */
	{0x1C, 0x36, 0x1C, 0x6E, 0x3B, 0x33, 0x6E, 0x00}, /* '&' */
	{0x06, 0x06, 0x03, 0x00, 0x00, 0x00, 0x00, 0x00}, /* ''' */
	{0x18, 0x0C, 0x06, 0x06, 0x06, 0x0C, 0x18, 0x00}, /* '(' */
	{0x06, 0x0C, 0x18, 0x18, 0x18, 0x0C, 0x06, 0x00}, /* ')' */
	{0x00, 0x66, 0x3C, 0xFF, 0x3C, 0x66, 0x00, 0x00}, /* '*' */
	{0x00, 0x0C, 0x0C, 0x3F, 0x0C, 0x0C, 0x00, 0x00}, /* '+' */
	{0x00, 0x00, 0x00, 0x00, 0x00, 0x0C, 0x0C, 0x06}, /* ',' */
	{0x00, 0x00, 0x00, 0x3F, 0x00, 0x00, 0x00, 0x00}, /* '-' */
	{0x00, 0x00, 0x00, 0x00, 0x00, 0x0C, 0x0C, 0x00}, /* '.' */
	{0x60, 0x30, 0x18, 0x0C, 0x06, 0x03, 0x01, 0x00}, /* '/' */
	{0x3E, 0x63, 0x73, 0x7B, 0x6F, 0x67, 0x3E, 0x00}, /* '0' */
	{0x0C, 0x0E, 0x0C, 0x0C, 0x0C, 0x0C, 0x3F, 0x00}, /* '1' */
	{0x1E, 0x33, 0x30, 0x1C, 0x06, 0x33, 0x3F, 0x00}, /* '2' */
	{0x1E, 0x33, 0x30, 0x1C, 0x30, 0x33, 0x1E, 0x00}, /* '3' */
	{0x38, 0x3C, 0x36, 0x33, 0x7F, 0x30, 0x78, 0x00}, /* '4' */
	{0x3F, 0x03, 0x1F, 0x30, 0x30, 0x33, 0x1E, 0x00}, /* '5' */
	{0x1C, 0x06, 0x03, 0x1F, 0x33, 0x33, 0x1E, 0x00}, /* '6' */
	{0x3F, 0x33, 0x30, 0x18, 0x0C, 0x0C, 0x0C, 0x00}, /* '7' */
	{0x1E, 0x33, 0x33, 0x1E, 0x33, 0x33, 0x1E, 0x00}, /* '8' */
	{0x1E, 0x33, 0x33, 0x3E, 0x30, 0x18, 0x0E, 0x00}, /* '9' */
	{0x00, 0x0C, 0x0C, 0x00, 0x00, 0x0C, 0x0C, 0x00}, /* ':' */
	{0x00, 0x0C, 0x0C, 0x00, 0x00, 0x0C, 0x0C, 0x06}, /* ';' */
	{0x18, 0x0C, 0x06, 0x03, 0x06, 0x0C, 0x18, 0x00}, /* '<' */
	{0x00, 0x00, 0x3F, 0x00, 0x00, 0x3F, 0x00, 0x00}, /* '=' */
	{0x06, 0x0C, 0x18, 0x30, 0x18, 0x0C, 0x06, 0x00}, /* '>' */
	{0x1E, 0x33, 0x30, 0x18, 0x0C, 0x00, 0x0C, 0x00}, /* '?' */
	{0x3E, 0x63, 0x7B, 0x7B, 0x7B, 0x03, 0x1E, 0x00}, /* '@' */
	{0x0C, 0x1E, 0x33, 0x33, 0x3F, 0x33, 0x33, 0x00}, /* 'A' */
	{0x3F, 0x66, 0x66, 0x3E, 0x66, 0x66, 0x3F, 0x00}, /* 'B' */
	{0x3C, 0x66, 0x03, 0x03, 0x03, 0x66, 0x3C, 0x00}, /* 'C' */
	{0x1F, 0x36, 0x66, 0x66, 0x66, 0x36, 0x1F, 0x00}, /* 'D' */
	{0x7F, 0x46, 0x16, 0x1E, 0x16, 0x46, 0x7F, 0x00}, /* 'E' */
	{0x7F, 0x46, 0x16, 0x1E, 0x16, 0x06, 0x0F, 0x00}, /* 'F' */
	{0x3C, 0x66, 0x03, 0x03, 0x73, 0x66, 0x7C, 0x00}, /* 'G' */
	{0x33, 0x33, 0x33, 0x3F, 0x33, 0x33, 0x33, 0x00}, /* 'H' */
	{0x1E, 0x0C, 0x0C, 0x0C, 0x0C, 0x0C, 0x1E, 0x00}, /* 'I' */
	{0x78, 0x30, 0x30, 0x30, 0x33, 0x33, 0x1E, 0x00}, /* 'J' */
	{0x67, 0x66, 0x36, 0x1E, 0x36, 0x66, 0x67, 0x00}, /* 'K' */
	{0x0F, 0x06, 0x06, 0x06, 0x46, 0x66, 0x7F, 0x00}, /* 'L' */
	{0x63, 0x77, 0x7F, 0x7F, 0x6B, 0x63, 0x63, 0x00}, /* 'M' */
	{0x63, 0x67, 0x6F, 0x7B, 0x73, 0x63, 0x63, 0x00}, /* 'N' */
	{0x1C, 0x36, 0x63, 0x63, 0x63, 0x36, 0x1C, 0x00}, /* 'O' */
	{0x3F, 0x66, 0x66, 0x3E, 0x06, 0x06, 0x0F, 0x00}, /* 'P' */
	{0x1E, 0x33, 0x33, 0x33, 0x3B, 0x1E, 0x38, 0x00}, /* 'Q' */
	{0x3F, 0x66, 0x66, 0x3E, 0x36, 0x66, 0x67, 0x00}, /* 'R' */
	{0x1E, 0x33, 0x07, 0x0E, 0x38, 0x33, 0x1E, 0x00}, /* 'S' */
	{0x3F, 0x2D, 0x0C, 0x0C, 0x0C, 0x0C, 0x1E, 0x00}, /* 'T' */
	{0x33, 0x33, 0x33, 0x33, 0x33, 0x33, 0x3F, 0x00}, /* 'U' */
	{0x33, 0x33, 0x33, 0x33, 0x33, 0x1E, 0x0C, 0x00}, /* 'V' */
	{0x63, 0x63, 0x63, 0x6B, 0x7F, 0x77, 0x63, 0x00}, /* 'W' */
	{0x63, 0x63, 0x36, 0x1C, 0x1C, 0x36, 0x63, 0x00}, /* 'X' */
	{0x33, 0x33, 0x33, 0x1E, 0x0C, 0x0C, 0x1E, 0x00}, /* 'Y' */
	{0x7F, 0x63, 0x31, 0x18, 0x4C, 0x66, 0x7F, 0x00}, /* 'Z' */
	{0x1E, 0x06, 0x06, 0x06, 0x06, 0x06, 0x1E, 0x00}, /* '[' */
	{0x03, 0x06, 0x0C, 0x18, 0x30, 0x60, 0x40, 0x00}, /* '\' */
	{0x1E, 0x18, 0x18, 0x18, 0x18, 0x18, 0x1E, 0x00}, /* ']' */
	{0x08, 0x1C, 0x36, 0x63, 0x00, 0x00, 0x00, 0x00}, /* '^' */
	{0x00, 0x00, 0x00, 0x00, 0x00, 0x00, 0x00, 0xFF}, /* '_' */
	{0x0C, 0x0C, 0x18, 0x00, 0x00, 0x00, 0x00, 0x00}, /* '`' */
	{0x00, 0x00, 0x1E, 0x30, 0x3E, 0x33, 0x6E, 0x00}, /* 'a' */
	{0x07, 0x06, 0x06, 0x3E, 0x66, 0x66, 0x3B, 0x00}, /* 'b' */
	{0x00, 0x00, 0x1E, 0x33, 0x03, 0x33, 0x1E, 0x00}, /* 'c' */
	{0x38, 0x30, 0x30, 0x3E, 0x33, 0x33, 0x6E, 0x00}, /* 'd' */
	{0x00, 0x00, 0x1E, 0x33, 0x3F, 0x03, 0x1E, 0x00}, /* 'e' */
	{0x1C, 0x36, 0x06, 0x0F, 0x06, 0x06, 0x0F, 0x00}, /* 'f' */
	{0x00, 0x00, 0x6E, 0x33, 0x33, 0x3E, 0x30, 0x1F}, /* 'g' */
	{0x07, 0x06, 0x36, 0x6E, 0x66, 0x66, 0x67, 0x00}, /* 'h' */
	{0x0C, 0x00, 0x0E, 0x0C, 0x0C, 0x0C, 0x1E, 0x00}, /* 'i' */
	{0x30, 0x00, 0x30, 0x30, 0x30, 0x33, 0x33, 0x1E}, /* 'j' */
	{0x07, 0x06, 0x66, 0x36, 0x1E, 0x36, 0x67, 0x00}, /* 'k' */
	{0x0E, 0x0C, 0x0C, 0x0C, 0x0C, 0x0C, 0x1E, 0x00}, /* 'l' */
	{0x00, 0x00, 0x33, 0x7F, 0x7F, 0x6B, 0x63, 0x00}, /* 'm' */
	{0x00, 0x00, 0x1F, 0x33, 0x33, 0x33, 0x33, 0x00}, /* 'n' */
	{0x00, 0x00, 0x1E, 0x33, 0x33, 0x33, 0x1E, 0x00}, /* 'o' */
	{0x00, 0x00, 0x3B, 0x66, 0x66, 0x3E, 0x06, 0x0F}, /* 'p' */
	{0x00, 0x00, 0x6E, 0x33, 0x33, 0x3E, 0x30, 0x78}, /* 'q' */
	{0x00, 0x00, 0x3B, 0x6E, 0x66, 0x06, 0x0F, 0x00}, /* 'r' */
	{0x00, 0x00, 0x3E, 0x03, 0x1E, 0x30, 0x1F, 0x00}, /* 's' */
	{0x08, 0x0C, 0x3E, 0x0C, 0x0C, 0x2C, 0x18, 0x00}, /* 't' */
	{0x00, 0x00, 0x33, 0x33, 0x33, 0x33, 0x6E, 0x00}, /* 'u' */
	{0x00, 0x00, 0x33, 0x33, 0x33, 0x1E, 0x0C, 0x00}, /* 'v' */
	{0x00, 0x00, 0x63, 0x6B, 0x7F, 0x7F, 0x36, 0x00}, /* 'w' */
	{0x00, 0x00, 0x63, 0x36, 0x1C, 0x36, 0x63, 0x00}, /* 'x' */
	{0x00, 0x00, 0x33, 0x33, 0x33, 0x3E, 0x30, 0x1F}, /* 'y' */
	{0x00, 0x00, 0x3F, 0x19, 0x0C, 0x26, 0x3F, 0x00}, /* 'z' */
	{0x38, 0x0C, 0x0C, 0x07, 0x0C, 0x0C, 0x38, 0x00}, /* '{' */
	{0x18, 0x18, 0x18, 0x00, 0x18, 0x18, 0x18, 0x00}, /* '|' */
	{0x07, 0x0C, 0x0C, 0x38, 0x0C, 0x0C, 0x07, 0x00}, /* '}' */
	{0x6E, 0x3B, 0x00, 0x00, 0x00, 0x00, 0x00, 0x00}, /* '~' */
	{0x00, 0x00, 0x00, 0x00, 0x00, 0x00, 0x00, 0x00}, /* 0x7F */
};

int gfx_init(void)
{
	struct display_capabilities caps;

	disp = DEVICE_DT_GET(DT_CHOSEN(zephyr_display));
	if (!device_is_ready(disp)) {
		disp = NULL;
		return -ENODEV;
	}

	(void)display_set_pixel_format(disp, PIXEL_FORMAT_RGB_565);
	display_get_capabilities(disp, &caps);
	g_w = MIN(caps.x_resolution, GFX_MAX_W);
	g_h = MIN(caps.y_resolution, GFX_MAX_H);
	display_blanking_off(disp);
	return 0;
}

bool gfx_ready(void)
{
	return disp != NULL;
}

uint16_t gfx_width(void)
{
	return g_w;
}

uint16_t gfx_height(void)
{
	return g_h;
}

void gfx_fill_rect(int x, int y, int w, int h, uint16_t color)
{
	struct display_buffer_descriptor desc;

	if (disp == NULL) {
		return;
	}

	/* Clip to the screen. */
	if (x < 0) {
		w += x;
		x = 0;
	}
	if (y < 0) {
		h += y;
		y = 0;
	}
	if (x + w > g_w) {
		w = g_w - x;
	}
	if (y + h > g_h) {
		h = g_h - y;
	}
	if (w <= 0 || h <= 0) {
		return;
	}

	for (int i = 0; i < w * CHUNK_H; i++) {
		chunk_buf[i] = color;
	}

	desc.width = w;
	desc.pitch = w;
	for (int yy = y; yy < y + h; yy += CHUNK_H) {
		int rows = MIN(CHUNK_H, y + h - yy);

		desc.height = rows;
		desc.buf_size = (size_t)w * rows * sizeof(uint16_t);
		(void)display_write(disp, x, yy, &desc, chunk_buf);
	}
}

void gfx_clear(uint16_t color)
{
	gfx_fill_rect(0, 0, g_w, g_h, color);
}

void gfx_text(int x, int y, const char *s, uint16_t fg, uint16_t bg, int scale)
{
	struct display_buffer_descriptor desc;

	if (disp == NULL || s == NULL) {
		return;
	}
	if (scale < 1) {
		scale = 1;
	}
	if (scale > GLYPH_MAX_SCALE) {
		scale = GLYPH_MAX_SCALE;
	}

	const int gw = 8 * scale;

	desc.width = gw;
	desc.height = gw;
	desc.pitch = gw;
	desc.buf_size = (size_t)gw * gw * sizeof(uint16_t);

	for (const char *p = s; *p != '\0'; p++, x += gw) {
		uint8_t c = (uint8_t)*p;
		const uint8_t *rows;

		if (x >= g_w) {
			break;
		}
		if (c < 0x20 || c > 0x7F) {
			c = '?';
		}
		rows = font8x8[c - 0x20];

		for (int ry = 0; ry < 8; ry++) {
			for (int rx = 0; rx < 8; rx++) {
				uint16_t px = (rows[ry] >> rx) & 1 ? fg : bg;

				for (int sy = 0; sy < scale; sy++) {
					uint16_t *line = &glyph_buf[(ry * scale + sy) * gw + rx * scale];

					for (int sx = 0; sx < scale; sx++) {
						line[sx] = px;
					}
				}
			}
		}

		(void)display_write(disp, x, y, &desc, glyph_buf);
	}
}

int gfx_text_w(const char *s, int scale)
{
	if (scale < 1) {
		scale = 1;
	}
	return (int)strlen(s) * 8 * scale;
}

void gfx_present(void)
{
#if IS_ENABLED(CONFIG_ST7701_PRESTO_DOUBLE_BUFFER)
	if (disp != NULL) {
		st7701_presto_flip(disp);
	}
#endif
}
```

## src/gfx.h
```c
/*
 * SPDX-License-Identifier: MIT
 *
 * Minimal RGB565 drawing layer over the Zephyr display API for the kitchen_sink
 * demo: solid rectangles and 8x8 bitmap-font text, presented tear-free via the
 * ST7701 vblank flip when double-buffering is enabled. Coordinates are in the
 * display's pixel space (240x240 on the Presto at half-res). All colours are
 * standard little-endian PIXEL_FORMAT_RGB_565; display_write() byteswaps them
 * for the panel.
 */

#ifndef KITCHEN_SINK_GFX_H_
#define KITCHEN_SINK_GFX_H_

#include <stdbool.h>
#include <stdint.h>

/* RGB565 palette (little-endian, as accepted by display_write). */
#define COL_BLACK  0x0000
#define COL_WHITE  0xFFFF
#define COL_RED    0xF800
#define COL_GREEN  0x07E0
#define COL_BLUE   0x001F
#define COL_YELLOW 0xFFE0
#define COL_CYAN   0x07FF
#define COL_MAGENTA 0xF81F
#define COL_AMBER  0xFD20
#define COL_GREY   0x8410
#define COL_DKGREY 0x4208
#define COL_NAVY   0x0010

/* Resolve the chosen display, select RGB565, cache the (clamped) size and turn
 * blanking off. Returns 0 on success, negative if no usable display.
 */
int gfx_init(void);
bool gfx_ready(void);
uint16_t gfx_width(void);
uint16_t gfx_height(void);

/* Fill the whole screen / a clipped rectangle with a solid colour. */
void gfx_clear(uint16_t color);
void gfx_fill_rect(int x, int y, int w, int h, uint16_t color);

/* Draw a NUL-terminated ASCII string with the 8x8 font at integer scale
 * (1 -> 8 px tall, 2 -> 16 px, ...). Both fg and bg are opaque; draw onto a
 * known background (pass that colour as bg). gfx_text_w() returns the pixel
 * width of a string for centring.
 */
void gfx_text(int x, int y, const char *s, uint16_t fg, uint16_t bg, int scale);
int gfx_text_w(const char *s, int scale);

/* Present the rendered frame (vblank flip if double-buffered; else a no-op). */
void gfx_present(void);

#endif /* KITCHEN_SINK_GFX_H_ */
```

## src/screen_button.c
```c
/*
 * SPDX-License-Identifier: MIT
 *
 * Button screen: shows the live USER_SW (GP46) state.
 */

#include <zephyr/drivers/gpio.h>
#include <zephyr/kernel.h>
#include <zephyr/logging/log.h>

#include "screens.h"
#include "ui.h"

LOG_MODULE_REGISTER(screen_button, LOG_LEVEL_INF);

static const struct gpio_dt_spec sw = GPIO_DT_SPEC_GET(DT_ALIAS(sw0), gpios);
static int level; /* 0/1, or -1 unknown */
static bool ready;

static int button_enter(void)
{
	ready = device_is_ready(sw.port);
	if (ready) {
		(void)gpio_pin_configure_dt(&sw, GPIO_INPUT);
	} else {
		LOG_WRN("USER_SW not ready");
	}
	level = -1;
	return ready ? 0 : -ENODEV;
}

static bool button_update(void)
{
	if (!ready) {
		return false;
	}

	int v = gpio_pin_get_dt(&sw);

	if (v < 0 || v == level) {
		return false;
	}
	level = v;
	return true;
}

static void button_render(void)
{
	ui_begin("Button", COL_CYAN);

	if (!ready) {
		gfx_text(8, 96, "USER_SW n/a", COL_GREY, UI_BG, 2);
		ui_footer();
		return;
	}

	bool pressed = level == 1;
	uint16_t box = pressed ? COL_GREEN : COL_DKGREY;
	const char *s = pressed ? "PRESSED" : "released";

	gfx_fill_rect(40, 72, gfx_width() - 80, 88, box);
	gfx_text((gfx_width() - gfx_text_w(s, 2)) / 2, 108, s, COL_WHITE, box, 2);
	gfx_text(8, 184, "USER_SW = GP46", COL_WHITE, UI_BG, 1);
	ui_footer();
}

static void button_leave(void)
{
}

static const struct screen instance = {
	.name = "button",
	.enter = button_enter,
	.update = button_update,
	.render = button_render,
	.leave = button_leave,
};

const struct screen *screen_button(void)
{
	return &instance;
}
```

## src/screen_neopixel.c
```c
/*
 * SPDX-License-Identifier: MIT
 *
 * NeoPixel screen: drives the 7-LED chain with a rotating colour wheel and
 * mirrors it as on-screen swatches. On native_sim (no LED strip) it animates
 * the swatches alone.
 */

#include <zephyr/kernel.h>
#include <zephyr/logging/log.h>
#include <string.h>

#include "screens.h"
#include "ui.h"

LOG_MODULE_REGISTER(screen_neopixel, LOG_LEVEL_INF);

#define SWATCH_Y 64
#define SWATCH_H 96

#if IS_ENABLED(CONFIG_LED_STRIP)

#include <zephyr/device.h>
#include <zephyr/drivers/led_strip.h>

#define STRIP_NODE DT_ALIAS(led_strip)
#define STRIP_LEN  DT_PROP_OR(STRIP_NODE, chain_length, 7)

/* Advance the colour wheel one position every WHEEL_TICKS ticks (TICK_MS=50ms),
 * i.e. ~5 steps/s — a gentle rotation instead of a blur. */
#define WHEEL_TICKS 4

static const struct device *const strip = DEVICE_DT_GET(STRIP_NODE);
static struct led_rgb pixels[STRIP_LEN];
static size_t step;
static unsigned int ticks;
static bool have_strip;

static const struct led_rgb wheel[] = {
	{ .r = 0x18, .g = 0x00, .b = 0x00 }, { .r = 0x18, .g = 0x0c, .b = 0x00 },
	{ .r = 0x18, .g = 0x18, .b = 0x00 }, { .r = 0x00, .g = 0x18, .b = 0x00 },
	{ .r = 0x00, .g = 0x18, .b = 0x18 }, { .r = 0x00, .g = 0x00, .b = 0x18 },
	{ .r = 0x18, .g = 0x00, .b = 0x18 },
};

static void neopixel_show(void)
{
	for (size_t i = 0; i < STRIP_LEN; i++) {
		pixels[i] = wheel[(step + i) % ARRAY_SIZE(wheel)];
	}
	if (have_strip) {
		(void)led_strip_update_rgb(strip, pixels, STRIP_LEN);
	}
}

static int neopixel_enter(void)
{
	step = 0;
	ticks = 0;
	have_strip = device_is_ready(strip);
	if (!have_strip) {
		LOG_WRN("LED strip not ready");
	}
	neopixel_show(); /* paint the first frame so the wheel isn't blank on entry */
	return have_strip ? 0 : -ENODEV;
}

static bool neopixel_update(void)
{
	if (++ticks < WHEEL_TICKS) {
		return false; /* unchanged this tick — no LED write, no repaint */
	}
	ticks = 0;

	step++;
	neopixel_show();
	return true; /* swatches + LEDs advanced one position */
}

static void neopixel_render(void)
{
	int n = STRIP_LEN;
	int sw = gfx_width() / n;

	ui_begin("NeoPixel", COL_MAGENTA);
	for (int i = 0; i < n; i++) {
		struct led_rgb c = pixels[i];
		uint16_t col = ((c.r & 0xF8) << 8) | ((c.g & 0xFC) << 3) | (c.b >> 3);

		gfx_fill_rect(i * sw, SWATCH_Y, sw - 2, SWATCH_H, col);
	}
	gfx_text(8, SWATCH_Y + SWATCH_H + 12, have_strip ? "7x SK6812" : "no strip",
		 COL_WHITE, UI_BG, 1);
	ui_footer();
}

static void neopixel_leave(void)
{
	if (have_strip) {
		memset(pixels, 0, sizeof(pixels));
		(void)led_strip_update_rgb(strip, pixels, STRIP_LEN);
	}
}

#else /* no LED strip (native_sim): animate swatches only */

static int step;

static int neopixel_enter(void)
{
	step = 0;
	return 0;
}

static bool neopixel_update(void)
{
	step++;
	return true;
}

static void neopixel_render(void)
{
	static const uint16_t wheel[] = { COL_RED,  COL_AMBER, COL_YELLOW, COL_GREEN,
					  COL_CYAN, COL_BLUE,  COL_MAGENTA };
	int n = ARRAY_SIZE(wheel);
	int sw = gfx_width() / n;

	ui_begin("NeoPixel", COL_MAGENTA);
	for (int i = 0; i < n; i++) {
		gfx_fill_rect(i * sw, SWATCH_Y, sw - 2, SWATCH_H,
			      wheel[(step + i) % n]);
	}
	gfx_text(8, SWATCH_Y + SWATCH_H + 12, "(simulated)", COL_GREY, UI_BG, 1);
	ui_footer();
}

static void neopixel_leave(void)
{
}

#endif /* CONFIG_LED_STRIP */

static const struct screen instance = {
	.name = "neopixel",
	.enter = neopixel_enter,
	.update = neopixel_update,
	.render = neopixel_render,
	.leave = neopixel_leave,
};

const struct screen *screen_neopixel(void)
{
	return &instance;
}
```

## src/screen_psram.c
```c
/*
 * SPDX-License-Identifier: MIT
 *
 * PSRAM screen: shows the detected 8 MB APS6404 size and its mapped base.
 */

#include <zephyr/kernel.h>
#include <zephyr/devicetree.h>
#include <zephyr/logging/log.h>
#include <stdio.h>

#include "screens.h"
#include "ui.h"

LOG_MODULE_REGISTER(screen_psram, LOG_LEVEL_INF);

#if IS_ENABLED(CONFIG_PIMORONI_RP2350_PSRAM)

/* Provided by the PSRAM driver (drivers/presto/drivers/memc/psram_aps6404.c). */
extern size_t psram_get_size(void);

#define PSRAM_BASE DT_REG_ADDR(DT_NODELABEL(psram))

static size_t sz;

static int psram_enter(void)
{
	sz = psram_get_size();
	return sz ? 0 : -ENODEV;
}

static bool psram_update(void)
{
	return false; /* static content */
}

static void psram_render(void)
{
	char buf[24];

	ui_begin("PSRAM", COL_AMBER);

	if (sz == 0) {
		gfx_text(8, 96, "not detected", COL_GREY, UI_BG, 2);
		ui_footer();
		return;
	}

	snprintf(buf, sizeof(buf), "%u MiB", (unsigned)(sz >> 20));
	gfx_text(8, 64, buf, COL_WHITE, UI_BG, 3);

	snprintf(buf, sizeof(buf), "@ 0x%08lx", (unsigned long)PSRAM_BASE);
	gfx_text(8, 120, buf, COL_GREY, UI_BG, 2);

	gfx_text(8, 168, "APS6404 / QMI win1", COL_WHITE, UI_BG, 1);
	ui_footer();
}

static void psram_leave(void)
{
}

#else /* no PSRAM driver */

static int psram_enter(void)
{
	return 0;
}

static bool psram_update(void)
{
	return false;
}

static void psram_render(void)
{
	ui_begin("PSRAM", COL_AMBER);
	gfx_text(8, 96, "PSRAM n/a", COL_GREY, UI_BG, 2);
	ui_footer();
}

static void psram_leave(void)
{
}

#endif /* CONFIG_PIMORONI_RP2350_PSRAM */

static const struct screen instance = {
	.name = "psram",
	.enter = psram_enter,
	.update = psram_update,
	.render = psram_render,
	.leave = psram_leave,
};

const struct screen *screen_psram(void)
{
	return &instance;
}
```

## src/screen_touch.c
```c
/*
 * SPDX-License-Identifier: MIT
 *
 * Touch screen: draws a dot at the current FT6236 touch point and shows the
 * raw coordinates. The shared touch subscriber lives in touch.c.
 */

#include <zephyr/kernel.h>
#include <zephyr/logging/log.h>
#include <stdio.h>

#include "screens.h"
#include "touch.h"
#include "ui.h"

LOG_MODULE_REGISTER(screen_touch, LOG_LEVEL_INF);

static struct touch_point last;

static int touch_enter(void)
{
	last.x = 0;
	last.y = 0;
	last.pressed = false;
#if !IS_ENABLED(CONFIG_INPUT_FT6146)
	LOG_WRN("FT6236 driver disabled in this build");
#endif
	return 0;
}

static bool touch_update(void)
{
	struct touch_point t;

	touch_get(&t);
	if (t.x == last.x && t.y == last.y && t.pressed == last.pressed) {
		return false;
	}
	last = t;
	return true;
}

static void touch_render(void)
{
	ui_begin("Touch", COL_GREEN);

#if IS_ENABLED(CONFIG_INPUT_FT6146)
	if (last.pressed) {
		int px = (int)last.x * gfx_width() / TOUCH_RAW_MAX;
		int py = (int)last.y * gfx_height() / TOUCH_RAW_MAX;

		gfx_fill_rect(px - 6, py - 6, 12, 12, COL_WHITE);
	}

	gfx_text(8, 44, last.pressed ? "touching" : "touch the screen", COL_GREY,
		 UI_BG, 1);

	char buf[24];

	snprintf(buf, sizeof(buf), "x=%4d y=%4d", last.x, last.y);
	gfx_text(8, gfx_height() - 30, buf, COL_WHITE, UI_BG, 1);
#else
	gfx_text(8, 96, "touch n/a", COL_GREY, UI_BG, 2);
#endif

	ui_footer();
}

static void touch_leave(void)
{
}

static const struct screen instance = {
	.name = "touch",
	.enter = touch_enter,
	.update = touch_update,
	.render = touch_render,
	.leave = touch_leave,
};

const struct screen *screen_touch(void)
{
	return &instance;
}
```

## src/screen_wifi.c
```c
/*
 * SPDX-License-Identifier: MIT
 *
 * Wi-Fi screen: associates to the configured AP, takes a DHCP lease and shows
 * the SSID / state / IP on the panel. The connect is non-blocking; the net
 * management callbacks drive a small state machine. Mirrors apps/wifi_display.
 */

#include <zephyr/kernel.h>
#include <zephyr/logging/log.h>
#include <stdio.h>

#include "screens.h"
#include "ui.h"

LOG_MODULE_REGISTER(screen_wifi, LOG_LEVEL_INF);

#if IS_ENABLED(CONFIG_WIFI)

#include <zephyr/net/net_if.h>
#include <zephyr/net/net_mgmt.h>
#include <zephyr/net/net_event.h>
#include <zephyr/net/wifi_mgmt.h>
#include <zephyr/net/dhcpv4.h>

#define WIFI_MGMT_EVENTS (NET_EVENT_WIFI_CONNECT_RESULT | NET_EVENT_WIFI_DISCONNECT_RESULT)
#define SSID CONFIG_KITCHEN_SINK_WIFI_SSID
#define PSK  CONFIG_KITCHEN_SINK_WIFI_PSK

enum wifi_ui_state { WS_IDLE, WS_CONNECTING, WS_ASSOC, WS_BOUND, WS_ERR };

/* iface is set once (to a stable pointer) before any connect, so the callbacks
 * can read it without synchronisation. The mutable state below is shared
 * between the net-management callback thread and the UI thread, so it uses
 * atomics rather than volatile.
 */
static struct net_if *iface;
static struct net_mgmt_event_callback wifi_cb;
static struct net_mgmt_event_callback ipv4_cb;
static bool cbs_registered;
static bool dhcp_kicked;
static atomic_t ws_state = ATOMIC_INIT(WS_IDLE);
static atomic_t dirty;
static atomic_t last_status; /* status from the last connect result; <0 = no iface */
static char ip_str[NET_IPV4_ADDR_LEN];

/* The AIROC connect blocks (whd_wifi_join), so run it off the UI thread. */
static K_THREAD_STACK_DEFINE(conn_stack, 4096);
static struct k_thread conn_thread;
static K_SEM_DEFINE(connect_req, 0, 1);
static bool thread_started;
static int retries;
static int64_t err_ms; /* when the current error started; 0 = not erroring */

#define WIFI_MAX_RETRIES 3
#define WIFI_RETRY_MS    2000

static void set_state(enum wifi_ui_state s)
{
	atomic_set(&ws_state, s);
	atomic_set(&dirty, 1);
}

static void wifi_evt(struct net_mgmt_event_callback *cb, uint64_t event, struct net_if *fc)
{
	if (fc != iface) {
		return; /* not the interface this screen manages */
	}

	if (event == NET_EVENT_WIFI_CONNECT_RESULT) {
		const struct wifi_status *st = (const struct wifi_status *)cb->info;

		atomic_set(&last_status, st->status);
		set_state(st->status ? WS_ERR : WS_ASSOC); /* main loop kicks DHCP */
	} else if (event == NET_EVENT_WIFI_DISCONNECT_RESULT) {
		dhcp_kicked = false;
		set_state(WS_IDLE);
	}
}

static void ipv4_evt(struct net_mgmt_event_callback *cb, uint64_t event, struct net_if *fc)
{
	ARG_UNUSED(cb);

	if (event != NET_EVENT_IPV4_ADDR_ADD || fc != iface || fc->config.ip.ipv4 == NULL) {
		return;
	}
	for (int i = 0; i < NET_IF_MAX_IPV4_ADDR; i++) {
		if (fc->config.ip.ipv4->unicast[i].ipv4.addr_type != NET_ADDR_DHCP) {
			continue;
		}
		net_addr_ntop(NET_AF_INET, &fc->config.ip.ipv4->unicast[i].ipv4.address.in_addr,
			      ip_str, sizeof(ip_str));
		set_state(WS_BOUND);
		return;
	}
}

static void wifi_conn_fn(void *a, void *b, void *c)
{
	ARG_UNUSED(a);
	ARG_UNUSED(b);
	ARG_UNUSED(c);

	for (;;) {
		k_sem_take(&connect_req, K_FOREVER);
		if (iface == NULL) {
			continue;
		}

		struct wifi_connect_req_params p = {
			.ssid = (const uint8_t *)SSID,
			.ssid_length = sizeof(SSID) - 1,
			.psk = (const uint8_t *)PSK,
			.psk_length = sizeof(PSK) - 1,
			.security = (sizeof(PSK) - 1) ? WIFI_SECURITY_TYPE_PSK
						      : WIFI_SECURITY_TYPE_NONE,
			.channel = WIFI_CHANNEL_ANY,
			.band = WIFI_FREQ_BAND_2_4_GHZ,
			.mfp = WIFI_MFP_OPTIONAL,
		};

		LOG_INF("connecting to SSID \"%s\"", SSID);
		(void)net_mgmt(NET_REQUEST_WIFI_CONNECT, iface, &p, sizeof(p));
	}
}

static int wifi_enter(void)
{
	iface = net_if_get_default();
	atomic_set(&dirty, 1);

	if (!cbs_registered) {
		net_mgmt_init_event_callback(&wifi_cb, wifi_evt, WIFI_MGMT_EVENTS);
		net_mgmt_add_event_callback(&wifi_cb);
		net_mgmt_init_event_callback(&ipv4_cb, ipv4_evt, NET_EVENT_IPV4_ADDR_ADD);
		net_mgmt_add_event_callback(&ipv4_cb);
		cbs_registered = true;
	}

	if (!thread_started) {
		k_thread_create(&conn_thread, conn_stack, K_THREAD_STACK_SIZEOF(conn_stack),
				wifi_conn_fn, NULL, NULL, NULL, K_PRIO_PREEMPT(7), 0, K_NO_WAIT);
		k_thread_name_set(&conn_thread, "wifi_connect");
		thread_started = true;
	}

	if (iface == NULL) {
		LOG_WRN("no default network interface");
		atomic_set(&last_status, -1);
		atomic_set(&ws_state, WS_ERR);
		return -ENODEV;
	}

	/* Kick a connect off the UI thread (the AIROC join blocks). Re-entering
	 * after an error restarts the attempt.
	 */
	enum wifi_ui_state s = atomic_get(&ws_state);

	if ((s == WS_IDLE || s == WS_ERR) && sizeof(SSID) - 1 > 0) {
		retries = 0;
		err_ms = 0;
		dhcp_kicked = false;
		set_state(WS_CONNECTING);
		k_sem_give(&connect_req);
	}
	return 0;
}

static bool wifi_update(void)
{
	bool d = atomic_set(&dirty, 0) != 0;
	enum wifi_ui_state s = atomic_get(&ws_state);

	/* Start DHCP from the main thread once associated. */
	if (s == WS_ASSOC && !dhcp_kicked && iface != NULL) {
		net_dhcpv4_start(iface);
		dhcp_kicked = true;
	}

	/* The AIROC join can fail transiently under load — retry a few times. */
	if (s == WS_ERR && atomic_get(&last_status) >= 0 && retries < WIFI_MAX_RETRIES &&
	    iface != NULL) {
		if (err_ms == 0) {
			err_ms = k_uptime_get();
		} else if (k_uptime_get() - err_ms > WIFI_RETRY_MS) {
			retries++;
			err_ms = 0;
			dhcp_kicked = false;
			set_state(WS_CONNECTING);
			k_sem_give(&connect_req);
			d = true;
		}
	}
	return d;
}

static void wifi_render(void)
{
	char buf[20];
	const char *st;
	uint16_t c;
	int ls = atomic_get(&last_status);

	ui_begin("Wi-Fi", COL_BLUE);
	gfx_text(8, 44, (sizeof(SSID) - 1) ? SSID : "(no SSID set)", COL_WHITE, UI_BG, 2);

	switch (atomic_get(&ws_state)) {
	case WS_CONNECTING: st = "connecting"; c = COL_AMBER; break;
	case WS_ASSOC:      st = "getting IP"; c = COL_CYAN;  break;
	case WS_BOUND:      st = ip_str;       c = COL_GREEN; break;
	case WS_ERR:
		c = COL_RED;
		if (ls < 0) {
			st = "no iface";
		} else {
			snprintf(buf, sizeof(buf), "err %d", ls);
			st = buf;
		}
		break;
	default:            st = "idle";       c = COL_GREY;  break;
	}

	gfx_fill_rect(8, 92, gfx_width() - 16, 40, COL_DKGREY);
	gfx_text(16, 100, st, c, COL_DKGREY, 2);
	ui_footer();
}

static void wifi_leave(void)
{
}

#else /* no Wi-Fi */

static int wifi_enter(void)
{
	return 0;
}

static bool wifi_update(void)
{
	return false;
}

static void wifi_render(void)
{
	ui_begin("Wi-Fi", COL_BLUE);
	gfx_text(8, 96, "Wi-Fi n/a", COL_GREY, UI_BG, 2);
	ui_footer();
}

static void wifi_leave(void)
{
}

#endif /* CONFIG_WIFI */

static const struct screen instance = {
	.name = "wifi",
	.enter = wifi_enter,
	.update = wifi_update,
	.render = wifi_render,
	.leave = wifi_leave,
};

const struct screen *screen_wifi(void)
{
	return &instance;
}
```

## src/screens.h
```c
/*
 * SPDX-License-Identifier: MIT
 *
 * Screen interface for the kitchen_sink demo. Each "screen" is a name plus
 * callbacks. The main loop runs update() every tick (returning true when the
 * content changed) and calls render() to repaint the whole screen when a
 * present is due.
 */

#ifndef SCREENS_H_
#define SCREENS_H_

#include <stdbool.h>

struct screen {
	const char *name;
	int  (*enter)(void);    /* activate; return is informational — screens
				 * render their own "n/a" state, the dispatcher
				 * shows every screen regardless
				 */
	bool (*update)(void);   /* advance state; return true if it changed */
	void (*render)(void);   /* paint the ENTIRE screen to the back buffer */
	void (*leave)(void);
};

const struct screen *screen_neopixel(void);
const struct screen *screen_button(void);
const struct screen *screen_touch(void);
const struct screen *screen_wifi(void);
const struct screen *screen_psram(void);

#endif /* SCREENS_H_ */
```

## src/touch.c
```c
/*
 * SPDX-License-Identifier: MIT
 *
 * FT6236 touch + swipe detector (see touch.h). One global INPUT callback owns
 * the touch device for the whole app; screen_touch.c reads the live point via
 * touch_get(). On native_sim (no FT6236) this compiles to stubs.
 */

#include <zephyr/kernel.h>

#include "touch.h"

#if IS_ENABLED(CONFIG_INPUT_FT6146)

#include <zephyr/device.h>
#include <zephyr/input/input.h>
#include <stdlib.h>

#define TOUCH_NODE      DT_NODELABEL(ft6236)
#define SWIPE_DX_THRESH (TOUCH_RAW_MAX / 4) /* ~1/4 of the screen */

static const struct device *const touch = DEVICE_DT_GET(TOUCH_NODE);

/*
 * Live point packed into one atomic word so touch_get() can read it lock-free
 * while the input-callback thread updates it: x[11:0] y[23:12] pressed[24].
 */
static atomic_t live;

#define LIVE_PACK(x, y, p)                                                                          \
	(((uint32_t)((x) & 0xFFF)) | ((uint32_t)((y) & 0xFFF) << 12) | ((uint32_t)((p) ? 1 : 0) << 24))

static atomic_t pending_nav = ATOMIC_INIT(NAV_NONE);

/* Swipe FSM + current sample — only ever touched from the (serialised) input
 * callback thread.
 */
static int16_t cx, cy;
static bool cp;
static int16_t down_x, down_y;
static bool tracking;

static void on_input(struct input_event *evt, void *user_data)
{
	ARG_UNUSED(user_data);

	if (evt->dev != touch) {
		return;
	}

	switch (evt->code) {
	case INPUT_ABS_X:
		cx = (int16_t)evt->value;
		break;
	case INPUT_ABS_Y:
		cy = (int16_t)evt->value;
		break;
	case INPUT_BTN_TOUCH: {
		bool now = evt->value != 0;

		/* The FT6236 re-reports BTN_TOUCH on every sample, so latch the swipe
		 * origin only on the press edge and evaluate on the release edge.
		 */
		if (now && !cp) {
			down_x = cx;
			down_y = cy;
			tracking = true;
		} else if (!now && cp && tracking) {
			int dx = cx - down_x;
			int dy = cy - down_y;

			if (abs(dx) > SWIPE_DX_THRESH && abs(dx) > abs(dy)) {
				atomic_set(&pending_nav, dx < 0 ? NAV_LEFT : NAV_RIGHT);
			}
			tracking = false;
		}
		cp = now;
		break;
	}
	default:
		break;
	}

	atomic_set(&live, LIVE_PACK(cx, cy, cp));
}

INPUT_CALLBACK_DEFINE(NULL, on_input, NULL);

void touch_get(struct touch_point *out)
{
	uint32_t v = (uint32_t)atomic_get(&live);

	out->x = v & 0xFFF;
	out->y = (v >> 12) & 0xFFF;
	out->pressed = (v >> 24) & 1;
}

enum nav_dir touch_nav_take(void)
{
	return (enum nav_dir)atomic_set(&pending_nav, NAV_NONE);
}

#else /* no touch controller */

void touch_get(struct touch_point *out)
{
	out->x = 0;
	out->y = 0;
	out->pressed = false;
}

enum nav_dir touch_nav_take(void)
{
	return NAV_NONE;
}

#endif /* CONFIG_INPUT_FT6146 */
```

## src/touch.h
```c
/*
 * SPDX-License-Identifier: MIT
 *
 * Shared FT6236 touch handling for kitchen_sink: a single INPUT subscriber that
 * feeds both a live touch point (for the Touch screen to draw) and a left/right
 * swipe detector (for navigation). The swipe request is produced in the input
 * callback thread and consumed by the main loop.
 */

#ifndef KITCHEN_SINK_TOUCH_H_
#define KITCHEN_SINK_TOUCH_H_

#include <stdbool.h>
#include <stdint.h>

/* The FT6236 reports in the panel's native pixel space (~0..479), not the raw
 * 12-bit ADC range, so this is also the swipe/scale reference.
 */
#define TOUCH_RAW_MAX 480

/* Latest touch sample, in the controller's coordinate space (0..TOUCH_RAW_MAX). */
struct touch_point {
	int16_t x;
	int16_t y;
	bool pressed;
};

enum nav_dir {
	NAV_NONE = 0,
	NAV_LEFT,  /* swipe right-to-left -> next screen */
	NAV_RIGHT, /* swipe left-to-right -> previous screen */
};

/* Snapshot the latest touch point. */
void touch_get(struct touch_point *out);

/* Atomically read-and-clear a pending swipe navigation request. */
enum nav_dir touch_nav_take(void);

#endif /* KITCHEN_SINK_TOUCH_H_ */
```

## src/ui.c
```c
/* SPDX-License-Identifier: MIT */

#include "ui.h"

void ui_begin(const char *title, uint16_t accent)
{
	gfx_clear(UI_BG);
	gfx_text(8, 7, title, COL_WHITE, UI_BG, 2);
	gfx_fill_rect(0, UI_HEADER_H, gfx_width(), 2, accent);
}

void ui_footer(void)
{
	static const char hint[] = "< swipe >";

	gfx_text((gfx_width() - gfx_text_w(hint, 1)) / 2, gfx_height() - 12, hint,
		 COL_GREY, UI_BG, 1);
}
```

## src/ui.h
```c
/*
 * SPDX-License-Identifier: MIT
 *
 * Shared screen chrome for kitchen_sink: a title bar with an accent divider and
 * a centred "swipe" hint footer, so every screen has a consistent frame.
 */

#ifndef KITCHEN_SINK_UI_H_
#define KITCHEN_SINK_UI_H_

#include <stdint.h>

#include "gfx.h"

#define UI_BG       COL_NAVY
#define UI_HEADER_H 30

/* Clear to the background, draw the title (scale 2) and an accent divider. */
void ui_begin(const char *title, uint16_t accent);

/* Centred "< swipe >" hint near the bottom edge. */
void ui_footer(void);

#endif /* KITCHEN_SINK_UI_H_ */
```
