## drivers/presto/Kconfig
```kconfig
# Copyright (c) 2026 Jonathan Beri
# SPDX-License-Identifier: MIT

rsource "drivers/display/Kconfig"
rsource "drivers/led_strip/Kconfig"
rsource "drivers/memc/Kconfig"
```

## drivers/presto/drivers/display/Kconfig
```kconfig
# ST7701 parallel-RGB (DPI) PIO display driver for the Pimoroni Presto
#
# Copyright (c) 2026 Jonathan Beri
# SPDX-License-Identifier: MIT

config ST7701_PRESTO
	bool "Pimoroni Presto ST7701 parallel-RGB (DPI) PIO display"
	default y
	depends on DT_HAS_PIMORONI_ST7701_PRESTO_ENABLED
	select DISPLAY
	select GPIO
	select PICOSDK_USE_PIO
	select PICOSDK_USE_DMA
	select PICOSDK_USE_GPIO
	help
	  Driver for the ST7701S panel on the Pimoroni Presto, driven in 18bpp
	  parallel-RGB (DPI) mode over a 16-lane RGB565 bus using two RP2350 PIO1
	  state machines (pixel data + sync timing) plus a pair of DMA channels.
	  The framebuffer (480x480 RGB565, ~450 KB) lives in SRAM and is scanned
	  out continuously; display_write() blits into it.

	  Ported from the MIT-licensed Pimoroni firmware
	  (github.com/pimoroni/presto, drivers/st7701).

if ST7701_PRESTO

config ST7701_PRESTO_INIT_PRIORITY
	int "ST7701 Presto init priority"
	default 85
	help
	  Device init priority (POST_KERNEL). Must be after the PIO, DMA and
	  GPIO drivers.

config ST7701_PRESTO_HALF_RES
	bool "Half-resolution (240x240) framebuffer, pixel-doubled to the panel"
	help
	  Drive the 480x480 panel from a 240x240 RGB565 framebuffer (115 KB
	  instead of 450 KB), pixel- and line-doubled in the PIO/DMA scanout: the
	  parallel state machine runs at half the PCLK rate (each source pixel
	  spans two panel columns) and each source line is scanned twice. This
	  frees ~335 KB of SRAM so the networking stack can run alongside the
	  display. Panel timing and refresh rate are unchanged; only the effective
	  resolution is halved. Mirrors Pimoroni's full_res=false mode. The
	  framebuffer scans out of SRAM (the proven path) — unlike a PSRAM
	  framebuffer, which does not scan cleanly over the shared QMI bus.

config ST7701_PRESTO_DOUBLE_BUFFER
	bool "Double-buffer the framebuffer (tear-free, via vblank flip)"
	help
	  Allocate two framebuffers: the application renders into the back buffer
	  and calls st7701_presto_flip() to swap it in at the vertical blank, so a
	  frame is never shown half-drawn. Costs a second framebuffer in SRAM, so
	  in practice it pairs with CONFIG_ST7701_PRESTO_HALF_RES (two 240x240
	  buffers = 230 KB; two full-res buffers do not fit and fail a BUILD_ASSERT).

	  NOTE: this suits apps that regenerate the whole frame and then present
	  once (e.g. the gfx-based apps). It is NOT a good fit for a partial-update
	  GUI like LVGL on this panel: keeping the back buffer current every frame
	  means either copying from the live front buffer (CPU reads of that SRAM
	  stall the scanout DMA and flash garbage lines) or a full-screen redraw
	  every frame (congests the scanout pipeline). LVGL renders cleanly
	  single-buffered here, where only the small dirty regions are written.

endif # ST7701_PRESTO
```

## drivers/presto/drivers/input/Kconfig
```kconfig
# Copyright (c) 2026 Jonathan Beri
# SPDX-License-Identifier: MIT

config INPUT_PIMORONI_SCALER
	bool "Pimoroni input coordinate scaler"
	default y
	depends on DT_HAS_PIMORONI_INPUT_SCALER_ENABLED
	depends on INPUT
	help
	  Pseudo input device that subscribes to absolute-axis events from another
	  input device and re-reports them scaled by num/denom, passing other
	  events through unchanged. Used to map the Presto's FT6236 panel-space
	  (~0-480) touch coordinates onto a half-resolution 240x240 display before
	  the LVGL pointer glue clamps them to the display bounds.
```

## drivers/presto/drivers/led_strip/Kconfig
```kconfig
# WS2812/SK6812 PIO LED-strip driver for the Pimoroni Presto (RP2350B fork)
#
# Copyright (c) 2026 Jonathan Beri
# SPDX-License-Identifier: MIT

config WS2812_STRIP_PRESTO_PIO
	bool "Pimoroni Presto WS2812 PIO LED strip"
	default y
	depends on DT_HAS_PIMORONI_WS2812_PRESTO_PIO_ENABLED
	depends on LED_STRIP
	select PICOSDK_USE_PIO
	select PICOSDK_USE_DMA if DMA
	help
	  Presto-local fork of WS2812_STRIP_RPI_PICO_PIO that drives the 7x SK6812
	  ambient LED chain on GP33 over a Raspberry Pi Pico PIO state machine.
	  Adds the RP2350B fixes the upstream driver lacks: a pio_set_gpio_base(16)
	  call so the PIO can reach a GPIO > 31, and an absolute `out-pin` so the
	  data line resolves to GP33 rather than a gpio0_hi-relative cell.
```

## drivers/presto/drivers/memc/Kconfig
```kconfig
# Copyright (c) 2026 Jonathan Beri
# SPDX-License-Identifier: MIT

config PIMORONI_RP2350_PSRAM
	bool "Pimoroni Presto APS6404 PSRAM (RP2350 QMI window 1)"
	default y
	depends on DT_HAS_PIMORONI_RP2350_PSRAM_ENABLED
	help
	  Bring up the 8 MB APS6404 PSRAM on QMI CS1 (GP47) at boot and map it
	  into XIP space at 0x11000000. Ported from the MIT-licensed MicroPython
	  rp2 PSRAM init. Tag the devicetree node with zephyr,memory-attr and
	  enable CONFIG_MEM_ATTR_HEAP to allocate from it.

if PIMORONI_RP2350_PSRAM

config PIMORONI_RP2350_PSRAM_INIT_PRIORITY
	int "PSRAM init priority"
	default 5
	help
	  POST_KERNEL init priority. Runs after clocks/GPIO are up (the QMI
	  bring-up needs clk_sys at final speed) and before the application
	  main(), so the mem-attr heap can allocate from PSRAM.

module = PIMORONI_RP2350_PSRAM
module-str = Pimoroni RP2350 PSRAM
source "subsys/logging/Kconfig.template.log_config"

endif # PIMORONI_RP2350_PSRAM
```

## drivers/presto/dts/bindings/input/pimoroni,input-scaler.yaml
```yaml
# Copyright (c) 2026 Jonathan Beri
# SPDX-License-Identifier: MIT

description: |
  Input coordinate scaler pseudo-device. Subscribes to input events from the
  device referenced by 'input' and re-reports them as its own, with absolute
  X/Y values multiplied by scale-num and divided by scale-denom. All other
  events (e.g. INPUT_BTN_TOUCH) are passed through unchanged.

compatible: "pimoroni,input-scaler"

include: base.yaml

properties:
  input:
    type: phandle
    required: true
    description: Source input device whose events are scaled.
  scale-num:
    type: int
    default: 1
    description: Numerator of the coordinate scale factor.
  scale-denom:
    type: int
    default: 1
    description: Denominator of the coordinate scale factor (must be > 0).
```

## drivers/presto/dts/bindings/memory/pimoroni,rp2350-psram.yaml
```yaml
# Copyright (c) 2026 Jonathan Beri
# SPDX-License-Identifier: MIT

description: |
  Pimoroni Presto 8 MB APS6404 PSRAM on the RP2350B QMI window 1
  (chip-select CS1 = GP47), memory-mapped into XIP space at 0x11000000.

  A SYS_INIT driver (CONFIG_PIMORONI_RP2350_PSRAM) performs the QMI/APS6404
  bring-up at boot; after that the region is plain read/write RAM. Tag the
  node with `zephyr,memory-attr` (DT_MEM_ARM(ATTR_MPU_RAM) for the MPU window
  plus a DT_MEM_SW(ATTR_SW_ALLOC_*) tag) and enable CONFIG_MEM_ATTR_HEAP to
  allocate from it with mem_attr_heap_alloc().

compatible: "pimoroni,rp2350-psram"

include: [base.yaml, "zephyr,memory-region.yaml"]

properties:
  cs-pin:
    type: int
    required: true
    description: |
      RP2350 GPIO number wired to the APS6404 chip-select. Set to the QMI
      XIP_CS1 pad function by the driver (the Presto wires this to GP47).
```
